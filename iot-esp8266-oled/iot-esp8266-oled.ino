#include <ESP8266WiFi.h>
#include <ESP_SSD1306.h>
#include <SPI.h>            // only for compilation
#include <Wire.h>
#include <Button.h>
#include <Adafruit_GFX.h>

#define BUTTON_PIN 13
#define PULLUP true
#define INVERT true
#define DEBOUNCE_MS 20

#define OLED_RESET  16
#define PIN_SDA 14
#define PIN_SCL 12
#define I2C_ADDRESS 0x3c

#define HWX_LOGO_W 56
#define HWX_LOGO_H 64
#define OLED_WIDTH 128
#define OLED_HEIGHT 64

Button btn(BUTTON_PIN, PULLUP, INVERT, DEBOUNCE_MS);
ESP_SSD1306 oled(OLED_RESET);

unsigned long pressedAtMillis;
unsigned long const interval = 5000;
unsigned long pressedForMillis;

// ups logo for a splash screen
const unsigned char img [] PROGMEM = {
  0x00, 0x00, 0x00, 0x7e, 0x00, 0x00, 0x00, 0x00, 0x00, 0xfc, 0x00, 0x3f, 0x80, 0x00, 0x00, 0x1e,
  0x00, 0x00, 0x00, 0x78, 0x00, 0x00, 0xe0, 0x00, 0x00, 0x00, 0x03, 0x80, 0x06, 0x00, 0x00, 0x00,
  0x00, 0x00, 0x70, 0x18, 0x00, 0x00, 0x00, 0x00, 0x00, 0x0c, 0x40, 0x00, 0x00, 0x00, 0x00, 0x00,
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  0x00, 0x00, 0x00, 0x00, 0x00, 0x1c, 0x00, 0x00, 0x00, 0x00, 0x00, 0x00, 0x00, 0x00, 0x00, 0x00
};

void splashLogo() {
  oled.clearDisplay();
  // center the logo
  oled.drawBitmap((OLED_WIDTH - HWX_LOGO_W) / 2,
                  (OLED_HEIGHT - HWX_LOGO_H) / 2,
                  img, HWX_LOGO_W, HWX_LOGO_H, WHITE);
  oled.display();
}

void setup() {
  Serial.begin(115200);
  //  Wire.setClock(400000);
  Wire.begin(PIN_SDA, PIN_SCL);
  oled.begin(SSD1306_SWITCHCAPVCC, I2C_ADDRESS, true);
  //  oled.clearDisplay();
  splashLogo();
  delay(2000);
  oled.clearDisplay();

  oled.setTextSize(1);
  oled.setTextColor(WHITE);
  oled.setCursor(0, 0);
  oled.setTextWrap(true);

  ConfigureWifi();
}

void ConfigureWifi()
{

  String ssid = "ssid";
  String password = "password";

  Serial.print("Connecting to "); Serial.println(ssid.c_str());

  oled.println(String("Connecting to ") + ssid);
  oled.display();


  WiFi.begin (ssid.c_str(), password.c_str());
  while (WiFi.status() != WL_CONNECTED) {
    oled.println(".");
    oled.display();
    delay(500);
  }
  Serial.println("WiFi connected");
  Serial.println("IP address: ");
  Serial.println(WiFi.localIP());

  oled.println(String("IpAddress:") + WiFi.localIP().toString());
  oled.display();



}

void connectWiFi() {
  WiFi.mode(WIFI_STA);

  // Start SmartConfig if necessary
  if (WiFi.SSID() == "") {

    Serial.println("Beginning SmartConfig");
    oled.println("Beginning SmartConfig");
    oled.display();
    WiFi.beginSmartConfig();

    while (WiFi.status() != WL_CONNECTED) {
      delay(1000);
      Serial.print(".");
      oled.print(".");
      oled.display();
      if (WiFi.smartConfigDone()) {
        Serial.println();
        Serial.println("SmartConfig completed");
        oled.println();
        oled.println("SmartConfig completed");
        oled.display();
        WiFi.stopSmartConfig();
        delay(2000);
        break;
      }
    }
  } else {
    Serial.println(String("Using a saved SSID: ") + WiFi.SSID());
    oled.println(String("Using a saved SSID: ") + WiFi.SSID());
    oled.display();
  }

  Serial.print("Connecting..");
  oled.print("Connecting...");
  oled.display();
  WiFi.begin();
  while (WiFi.status() != WL_CONNECTED) {
    delay(1000);
    Serial.print(".");
    oled.print(".");
    oled.display();
  }
  Serial.println("Ok");
  oled.println("Ok");
  oled.display();

  Serial.println(String("My IP: ") + WiFi.localIP().toString());
  oled.println(String("My IP: ") + WiFi.localIP().toString());
  oled.display();
  delay(3000);
}

void displayOff() {
  return oled.ssd1306_command(0xAE);
}

void displayOn() {
  oled.ssd1306_command(0xAF);
}

void loop() {

  btn.read();

  if (btn.wasPressed()) {
    oled.clearDisplay();
    oled.setCursor(0, 30);
    oled.println("button pressed");
    oled.display();
    delay(3000);
    splashLogo();
  }



}
void loop1() {


  btn.read();

  if (btn.wasPressed()) {
    pressedAtMillis = millis();
  }

  if (btn.wasReleased()) {
    if (pressedForMillis > interval) {
      // we have a long press, reset
      displayOn();
      Serial.println("Resetting WiFi credentials");
      oled.invertDisplay(true);
      oled.println("Resetting WiFi credentials");
      oled.display();
      WiFi.disconnect();

      delay(3000);
      ESP.restart();
    } else {
      // short press, turn on the display
      displayOn();
      splashLogo();
      oled.clearDisplay();
      delay(3000);
      // somewhere around mid-screen with this font and size
      oled.setCursor(0, 30);
      oled.println(String("My IP: ") + WiFi.localIP().toString());
      oled.display();
      delay(3000);
      displayOff();
    }
  }

  pressedForMillis = millis() - pressedAtMillis;

  displayOff();

}
